#include "main.h"
typedef unsigned char uint8;

#define DisplayClear	 				0x01
#define ReturnHome					0x02
#define EntryModeSet(RL,S)				(0x04|(RL<<1)|S)
#define DisplayControl(D,C,B)				(0x08|(D<<2)|(C<<1)|(B))
#define CursorDisplayControl(SC,RL)			(0x10|(SC<<3)|(RL<<2))
#define FunctionSet(DL,RE,G)				(0x20|(DL<<4)|(RE<<2)|(G<<1))
#define SetCGRAMAddress(x)				(0x40|x)
#define SetDDRAMAddress(x)				(0x80|x)

/*-------------------------------------------------------------------------------
 * NHD-14432WG
 * 144x32 Graphic LCD
 * pin1 = VSS
 * pin2 = VDD
 * pin3 = V0
 * pin4 = RS = P3.0
 * sig5 = RW = P3.7
 * pin6 = E = P3.4
 * pin7-14 = Data = P1
 * pin15,16 = BKL
-------------------------------------------------------------------------------*/
void SetData(uint8 Data){
}
void ResetPinRS(void){
}
void SetPinRS(void){
}
void ResetPinRW(void){
}
void SetPinRW(void){
}
void ResetPinE(void){
}
void SetPinE(void){
}

void mdelay(int ms){
    usleep(1000*ms);
}
void Wcom(uint8 A){
    printf("Wcom: %02X\n", A);
    SetData(A); 
    ResetPinRS();
    ResetPinRW();
    SetPinE(); 
    /* From NewHaven Offical Sample Code, and we don't know which P3.1. */
    /*
    Set P3.1
    Reset P3.1
    */
    ResetPinE();
}

void Wdata(uint8 A){
    //printf("Wdata: %02X\n", A);
    SetData(A);
    SetPinRS(); 
    ResetPinRW(); 
    SetPinE(); 
    /* From NewHaven Offical Sample Code, and we don't know which P3.1. */
    /*
    Set P3.1
    Reset P3.1
    */
    ResetPinE();
}
uint8 Img1[]={
    0x00, 0x00, 0x00, 0x00, 0x00, 0x00, 0x00, 0x00, 0x00, 0x00, 0x00, 0x00, 0x00, 0x00, 0x00, 0x00, 0x00, 0x00,
    0x00, 0x00, 0x00, 0x00, 0x00, 0x00, 0x00, 0x00, 0x00, 0x00, 0x00, 0x00, 0x00, 0x00, 0x00, 0x00, 0x00, 0x00,
    0x00, 0x00, 0x00, 0x00, 0x00, 0x00, 0x00, 0x00, 0x00, 0x00, 0x00, 0x00, 0x00, 0x00, 0x00, 0x00, 0x00, 0x00,
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    0x00, 0x00, 0x00, 0x00, 0x00, 0x00, 0x00, 0x00, 0x00, 0x00, 0x00, 0x00, 0x00, 0x00, 0x00, 0x00, 0x00, 0x00
}; 
void Show(void){
    int i=0, j=0;
    for(i=0; i<32; i++){
        //Wcom(0x3E); 
	Wcom(FunctionSet(1,1,1));
	Wcom(SetDDRAMAddress(i));
	Wcom(SetDDRAMAddress(0));
        for(j=0; j<18; j++){
            Wdata(Img1[18*i+j]); 
        }
    }
}
void DisplayOff(void){
    printf("%s, %d: \n", __FUNCTION__, __LINE__);
    Wcom(FunctionSet(1,0,0));
    Wcom(DisplayControl(0,0,0));
}
void Init(void){
    printf("%s, %d: \n", __FUNCTION__, __LINE__);
    int i=0, j=0;
    /*
    Wcom(0x38); 
    Wcom(0x0C); 
    Wcom(0x06); 
    Wcom(0x02); 
    Wcom(0x01); 
    */
    Wcom(FunctionSet(1,0,0));
    Wcom(DisplayControl(1,0,0));
    Wcom(EntryModeSet(1,0));
    Wcom(ReturnHome);
    Wcom(DisplayClear);
    mdelay(2);
    for(i=0; i<32; i++){
        //Wcom(0x3E); 
	Wcom(FunctionSet(1,1,1));
	Wcom(SetDDRAMAddress(i));
	Wcom(SetDDRAMAddress(0));
        for(j=0; j<36; j++){
            Wdata(0x00); 
        }
    }
}

void Info(void){
    printf("DisplayControl(D,C,B): D: %d, C: %d, B:%d, Value: 0x%02X\n", 1, 0, 0, DisplayControl(1,0,0));
    printf("FunctionSet(DL,RE,G): DL: %d, RE: %d, G:%d, Value: 0x%02X\n", 1, 1, 0, FunctionSet(1,1,0));
    printf("FunctionSet(DL,RE,G): DL: %d, RE: %d, G:%d, Value: 0x%02X\n", 1, 1, 1, FunctionSet(1,1,1)|0x8);
    printf("SetDDRAMAddress(3): 0x%02X\n", SetDDRAMAddress(3));
}

int main(int argc, char *argv[]){
    Info();
    Init();
    Show();
    DisplayOff();
    return 0; 
}

